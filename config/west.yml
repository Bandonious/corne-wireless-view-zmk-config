## config/west.yml
```yaml
manifest:
  remotes:
    - name: zmkfirmware
      url-base: https://github.com/zmkfirmware
    - name: bandonious
      url-base: https://github.com/Bandonious

  projects:
    - name: zmk
      remote: zmkfirmware
      revision: v0.3
      import: app/west.yml

    - name: nice-view-mod-bd
      remote: bandonious
      revision: main

  self:
    path: config
    
```
